## firmware/main/Kconfig.projbuild
```kconfig
menu "AODV-EN App"

choice AODV_EN_APP_EXAMPLE_MODE
    prompt "Application example mode"
    default AODV_EN_APP_USE_APP_DEMO

config AODV_EN_APP_USE_APP_DEMO
    bool "Use app_demo (legacy periodic data example)"

config AODV_EN_APP_USE_PROTO_EXAMPLE
    bool "Use app_proto_example (health/text/command example)"

config AODV_EN_APP_USE_APP_FLOOD
    bool "Use app_flood (controlled flooding baseline)"

endchoice

config AODV_EN_APP_NODE_NAME
    string "Node name"
    default "NODE_A"

config AODV_EN_APP_NETWORK_ID
    hex "Network ID"
    default 0xA0DE0001

config AODV_EN_APP_WIFI_CHANNEL
    int "Wi-Fi channel"
    range 1 13
    default 6

config AODV_EN_APP_REPORT_TO_MAC
    string "Telemetria in-band: MAC da origem p/ reportar stats (vazio = desliga)"
    default ""
    help
      MAC do no de origem (coletor) para onde cada no nao-origem envia seus contadores
      (tx/rx/control/delivered) ao fim de cada janela, como DATA de aplicacao. A origem
      loga 'STATSREP node=<mac> ...'. Vazio desativa a telemetria in-band.

config AODV_EN_APP_REPORT_INTERVAL_MS
    int "Telemetria in-band: intervalo de envio do STATSREP (ms)"
    default 5000
    help
      Periodo entre envios do relatorio de stats (drenagem). O snapshot dos contadores
      e tirado ANTES do envio, entao o trafego da propria telemetria nao entra no valor
      reportado.

config AODV_EN_APP_TX_POWER_QDBM
    int "Max TX power (0.25 dBm units; 8..84 = 2..21 dBm; 0 = driver default)"
    range 0 84
    default 0
    help
      Potencia maxima de transmissao em unidades de 0,25 dBm (esp_wifi_set_max_tx_power).
      8 = 2 dBm (minimo, encurta alcance p/ forcar saltos na bancada);
      84 = 21 dBm (maximo). 0 mantem o padrao do driver.

config AODV_EN_APP_HELLO_INTERVAL_MS
    int "HELLO interval (ms)"
    range 1000 60000
    default 5000

config AODV_EN_APP_SEND_INTERVAL_MS
    int "DATA send interval (ms)"
    range 1000 60000
    default 7000

config AODV_EN_APP_PRINT_INTERVAL_MS
    int "Stats print interval (ms)"
    range 1000 60000
    default 10000

config AODV_EN_APP_FAIL_PERIOD_MS
    int "Failure-injection period (ms, 0=disabled)"
    default 0
    help
        Cenario C4 (falha/self-healing): periodo do ciclo de falha do no.
        0 desabilita. Quando >0, o no fica em silencio de radio (nao
        transmite HELLO/RREP/RERR/forward) durante FAIL_DOWN_MS a cada
        periodo, simulando queda e retorno do no.

config AODV_EN_APP_FAIL_DOWN_MS
    int "Failure-injection down time (ms)"
    default 0
    help
        Tempo de queda dentro de cada FAIL_PERIOD_MS (no qual o no nao
        transmite). Deve ser menor que FAIL_PERIOD_MS.

choice AODV_EN_APP_RREQ_FLOOD_MODE
    prompt "RREQ flooding mode"
    default AODV_EN_APP_RREQ_FLOOD_BROADCAST

config AODV_EN_APP_RREQ_FLOOD_BROADCAST
    bool "Broadcast (RFC 3561-style)"

config AODV_EN_APP_RREQ_FLOOD_UNICAST_SEQ
    bool "Unicast sequential for active neighbors (AODV-EN adaptation)"

endchoice

config AODV_EN_APP_DRIVER_MAX_PEERS
    int "Max dynamic ESP-NOW peers in adapter (LRU managed)"
    range 2 20
    default 20

config AODV_EN_APP_ROUTE_METRIC_HOP_WEIGHT
    int "Route metric hop weight"
    range 1 64
    default 8

config AODV_EN_APP_ROUTE_METRIC_RSSI_WEIGHT
    int "Route metric RSSI penalty weight"
    range 0 64
    default 1

config AODV_EN_APP_ROUTE_RSSI_BEST_DBM
    int "Route metric RSSI best threshold (dBm)"
    range -100 -30
    default -55

config AODV_EN_APP_ROUTE_RSSI_WORST_DBM
    int "Route metric RSSI worst threshold (dBm)"
    range -100 -30
    default -90

config AODV_EN_APP_ENABLE_DATA
    bool "Enable periodic DATA send"
    default n

config AODV_EN_APP_TARGET_MAC
    string "Target MAC for DATA"
    default ""
    depends on AODV_EN_APP_ENABLE_DATA

config AODV_EN_APP_PAYLOAD_TEXT
    string "Payload text"
    default "hello from aodv-en"
    depends on AODV_EN_APP_ENABLE_DATA

config AODV_EN_APP_PROTO_HEALTH_INTERVAL_MS
    int "PROTO health interval (ms)"
    range 1000 60000
    default 10000
    depends on AODV_EN_APP_USE_PROTO_EXAMPLE

config AODV_EN_APP_PROTO_UNICAST_INTERVAL_MS
    int "PROTO unicast interval (ms)"
    range 1000 60000
    default 15000
    depends on AODV_EN_APP_USE_PROTO_EXAMPLE

config AODV_EN_APP_PROTO_ENABLE_UNICAST
    bool "PROTO enable periodic unicast text/cmd"
    default n
    depends on AODV_EN_APP_USE_PROTO_EXAMPLE

config AODV_EN_APP_PROTO_ENABLE_CLI
    bool "PROTO enable serial CLI commands"
    default y
    depends on AODV_EN_APP_USE_PROTO_EXAMPLE

config AODV_EN_APP_PROTO_TARGET_MAC
    string "PROTO target MAC (unicast)"
    default ""
    depends on AODV_EN_APP_PROTO_ENABLE_UNICAST

config AODV_EN_APP_PROTO_TEXT
    string "PROTO text payload"
    default "oi from app proto"
    depends on AODV_EN_APP_PROTO_ENABLE_UNICAST

config AODV_EN_APP_PROTO_COMMAND
    string "PROTO command name"
    default "ping"
    depends on AODV_EN_APP_PROTO_ENABLE_UNICAST

config AODV_EN_APP_PROTO_COMMAND_ARGS
    string "PROTO command args"
    default ""
    depends on AODV_EN_APP_PROTO_ENABLE_UNICAST

endmenu
```
